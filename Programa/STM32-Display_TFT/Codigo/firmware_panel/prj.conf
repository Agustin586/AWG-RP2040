## CMakeLists.txt
```
# SPDX-License-Identifier: Apache-2.0

cmake_minimum_required(VERSION 3.20.0)

set(BOARD nucleo_h755zi_q/stm32h755xx/m7)

set(ZEPHYR_BASE "D:/aguat/Documents/GitHub/STM32/zephyrProject/deps/zephyr" CACHE PATH "Zephyr base directory")

set(DTC_OVERLAY_FILE
    ${CMAKE_CURRENT_SOURCE_DIR}/overlays/app.overlay
    ${CMAKE_CURRENT_SOURCE_DIR}/overlays/spi_ipc.overlay
    ${CMAKE_CURRENT_SOURCE_DIR}/overlays/btn.overlay
)

find_package(Zephyr REQUIRED HINTS ${ZEPHYR_BASE})
project(firmware_panel)

target_include_directories(app PRIVATE commons src)

add_subdirectory(commons)
add_subdirectory(src)
add_subdirectory(ztest)
```

## prj.conf
```kconfig
# GPIO
CONFIG_GPIO=y
CONFIG_INPUT=y
CONFIG_INPUT_GPIO_KEYS=y

# Logging
CONFIG_LOG=y
CONFIG_LOG_DEFAULT_LEVEL=3
CONFIG_LOG_MODE_IMMEDIATE=y

# Console y Serial
CONFIG_SERIAL=y
CONFIG_UART_CONSOLE=y
CONFIG_CONSOLE=y
CONFIG_PRINTK=y
CONFIG_EARLY_CONSOLE=y

# SPI
CONFIG_SPI=y
```

## src/main.c
```c
/**
 * @file 	main.c
 * @brief 	Archivo principal
 * @author	Agustin M. Zuliani
 * @date	26/03/26
 * @copyright	Agustin M. Zuliani (c) 2026
 */

/*=================================[ includes ]=================================*/

#include <zephyr/device.h>
#include <zephyr/devicetree.h>
#include <zephyr/drivers/display.h>
#include <zephyr/kernel.h>
#include <zephyr/logging/log.h>
#include <zephyr/drivers/gpio.h>
#include <string.h>

#include "msg_app_to_ipc.h"

/*============================[ macros and typedefs ]==========================*/

#define LED0_NODE	DT_ALIAS(led0)

/*===========================[ private declarations ]==========================*/

static const struct gpio_dt_spec led = GPIO_DT_SPEC_GET(LED0_NODE, gpios);

LOG_MODULE_REGISTER(main, LOG_LEVEL_DBG);

/*=============================[ private functions ]===========================*/

static void led_init(void);
static void led_blink(void);

static void led_init(void)
{
	/* Verificar que el device está listo */
    if (!gpio_is_ready_dt(&led)) {
		LOG_ERR("GPIO device no listo");
        return;
    }

	int ret = gpio_pin_configure_dt(&led, GPIO_OUTPUT_ACTIVE);
	if (ret < 0)
	{
		LOG_ERR("Error al inicializar el led");
	}

	ret = gpio_pin_set_dt(&led, true);
	if (ret < 0)
	{
		LOG_ERR("Error al prender el led");
	}

	return;
}

static void led_blink(void)
{
	static int ret= 0;

	ret = gpio_pin_toggle_dt(&led);
	if (ret < 0)
	{
		LOG_ERR("Error al togglear el led");
	}
}

/*=============================[ public functions ]===========================*/

int main(void)
{
	LOG_DBG("main() iniciado");
	led_init();

    while (1) 
	{
		led_blink();
        k_sleep(K_MSEC(1000));
		// ztest_msg_app_to_ipc();
    }

    return 0;
}
```
