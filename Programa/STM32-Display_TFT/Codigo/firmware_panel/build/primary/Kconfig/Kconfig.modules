## Programa/STM32-Display_TFT/Codigo/firmware_panel/build/primary/Kconfig/Kconfig.modules
```kconfig
menu "cmsis (D:/aguat/Documents/GitHub/STM32/zephyrProject/deps/modules/hal/cmsis)"
osource "$(ZEPHYR_CMSIS_KCONFIG)"
config ZEPHYR_CMSIS_MODULE
	bool
	default y
endmenu
menu "cmsis-dsp (D:/aguat/Documents/GitHub/STM32/zephyrProject/deps/modules/lib/cmsis-dsp)"
osource "$(ZEPHYR_CMSIS_DSP_KCONFIG)"
config ZEPHYR_CMSIS_DSP_MODULE
	bool
	default y
endmenu
menu "cmsis_6 (D:/aguat/Documents/GitHub/STM32/zephyrProject/deps/modules/hal/cmsis_6)"
osource "$(ZEPHYR_CMSIS_6_KCONFIG)"
config ZEPHYR_CMSIS_6_MODULE
	bool
	default y
endmenu
config ZEPHYR_HAL_STM32_MODULE
	bool
	default y

config ZEPHYR_HAL_STM32_MODULE_BLOBS
	bool
menu "lvgl (D:/aguat/Documents/GitHub/STM32/zephyrProject/deps/modules/lib/gui/lvgl)"
osource "D:/aguat/Documents/GitHub/STM32/zephyrProject/deps/modules/lib/gui/lvgl/zephyr/Kconfig"
config ZEPHYR_LVGL_MODULE
	bool
	default y
endmenu
config ZEPHYR_MCUBOOT_MODULE
	bool
	default y
menu "percepio (D:/aguat/Documents/GitHub/STM32/zephyrProject/deps/modules/debug/percepio)"
osource "D:/aguat/Documents/GitHub/STM32/zephyrProject/deps/modules/debug/percepio/zephyr/Kconfig"
config ZEPHYR_PERCEPIO_MODULE
	bool
	default y
endmenu
menu "picolibc (D:/aguat/Documents/GitHub/STM32/zephyrProject/deps/modules/lib/picolibc)"
osource "D:/aguat/Documents/GitHub/STM32/zephyrProject/deps/modules/lib/picolibc/zephyr/Kconfig"
config ZEPHYR_PICOLIBC_MODULE
	bool
	default y
endmenu
menu "segger (D:/aguat/Documents/GitHub/STM32/zephyrProject/deps/modules/debug/segger)"
osource "$(ZEPHYR_SEGGER_KCONFIG)"
config ZEPHYR_SEGGER_MODULE
	bool
	default y
endmenu
```

## Programa/STM32-Display_TFT/Codigo/firmware_panel/build/primary/Kconfig/arch/Kconfig
```kconfig
# Load Zephyr Arch Kconfig descriptions.
osource "D:/aguat/Documents/GitHub/STM32/zephyrProject/deps/zephyr/arch/rx/Kconfig"
osource "D:/aguat/Documents/GitHub/STM32/zephyrProject/deps/zephyr/arch/x86/Kconfig"
osource "D:/aguat/Documents/GitHub/STM32/zephyrProject/deps/zephyr/arch/xtensa/Kconfig"
osource "D:/aguat/Documents/GitHub/STM32/zephyrProject/deps/zephyr/arch/sparc/Kconfig"
osource "D:/aguat/Documents/GitHub/STM32/zephyrProject/deps/zephyr/arch/riscv/Kconfig"
osource "D:/aguat/Documents/GitHub/STM32/zephyrProject/deps/zephyr/arch/posix/Kconfig"
osource "D:/aguat/Documents/GitHub/STM32/zephyrProject/deps/zephyr/arch/mips/Kconfig"
osource "D:/aguat/Documents/GitHub/STM32/zephyrProject/deps/zephyr/arch/arm64/Kconfig"
osource "D:/aguat/Documents/GitHub/STM32/zephyrProject/deps/zephyr/arch/arm/Kconfig"
osource "D:/aguat/Documents/GitHub/STM32/zephyrProject/deps/zephyr/arch/arc/Kconfig"
```

## Programa/STM32-Display_TFT/Codigo/firmware_panel/build/primary/Kconfig/boards/Kconfig.defconfig
```kconfig
# Load Zephyr board defconfig descriptions.
osource "D:/aguat/Documents/GitHub/STM32/zephyrProject/deps/zephyr/boards/st/nucleo_h755zi_q/Kconfig.defconfig"
```

## Programa/STM32-Display_TFT/Codigo/firmware_panel/build/primary/Kconfig/boards/Kconfig.nucleo_h755zi_q
```kconfig
# Load board Kconfig descriptions.
osource "D:/aguat/Documents/GitHub/STM32/zephyrProject/deps/zephyr/boards/st/nucleo_h755zi_q/Kconfig.nucleo_h755zi_q"
```

## Programa/STM32-Display_TFT/Codigo/firmware_panel/build/primary/Kconfig/boards/Kconfig.sysbuild
```kconfig
# Load Sysbuild board Kconfig descriptions.
osource "D:/aguat/Documents/GitHub/STM32/zephyrProject/deps/zephyr/boards/st/nucleo_h755zi_q/Kconfig.sysbuild"
```

## Programa/STM32-Display_TFT/Codigo/firmware_panel/build/primary/Kconfig/soc/Kconfig
```kconfig
# Load Zephyr SoC Kconfig descriptions.
osource "D:/aguat/Documents/GitHub/STM32/zephyrProject/deps/zephyr/soc/xlnx/zynqmp/Kconfig"
osource "D:/aguat/Documents/GitHub/STM32/zephyrProject/deps/zephyr/soc/xlnx/zynq7000/Kconfig"
osource "D:/aguat/Documents/GitHub/STM32/zephyrProject/deps/zephyr/soc/xlnx/versalnet/Kconfig"
osource "D:/aguat/Documents/GitHub/STM32/zephyrProject/deps/zephyr/soc/xlnx/versal2/Kconfig"
osource "D:/aguat/Documents/GitHub/STM32/zephyrProject/deps/zephyr/soc/xen/Kconfig"
osource "D:/aguat/Documents/GitHub/STM32/zephyrProject/deps/zephyr/soc/wch/ch32v/Kconfig"
osource "D:/aguat/Documents/GitHub/STM32/zephyrProject/deps/zephyr/soc/ti/simplelink/Kconfig"
osource "D:/aguat/Documents/GitHub/STM32/zephyrProject/deps/zephyr/soc/ti/mspm0/Kconfig"
osource "D:/aguat/Documents/GitHub/STM32/zephyrProject/deps/zephyr/soc/ti/lm3s6965/Kconfig"
osource "D:/aguat/Documents/GitHub/STM32/zephyrProject/deps/zephyr/soc/ti/k3/Kconfig"
osource "D:/aguat/Documents/GitHub/STM32/zephyrProject/deps/zephyr/soc/telink/tlsr/Kconfig"
osource "D:/aguat/Documents/GitHub/STM32/zephyrProject/deps/zephyr/soc/starfive/jh71xx/Kconfig"
osource "D:/aguat/Documents/GitHub/STM32/zephyrProject/deps/zephyr/soc/st/stm32/Kconfig"
osource "D:/aguat/Documents/GitHub/STM32/zephyrProject/deps/zephyr/soc/snps/qemu_arc/Kconfig"
osource "D:/aguat/Documents/GitHub/STM32/zephyrProject/deps/zephyr/soc/snps/nsim/arc_v/Kconfig"
osource "D:/aguat/Documents/GitHub/STM32/zephyrProject/deps/zephyr/soc/snps/nsim/arc_classic/Kconfig"
osource "D:/aguat/Documents/GitHub/STM32/zephyrProject/deps/zephyr/soc/snps/hsdk4xd/Kconfig"
osource "D:/aguat/Documents/GitHub/STM32/zephyrProject/deps/zephyr/soc/snps/hsdk/Kconfig"
osource "D:/aguat/Documents/GitHub/STM32/zephyrProject/deps/zephyr/soc/snps/emsk/Kconfig"
osource "D:/aguat/Documents/GitHub/STM32/zephyrProject/deps/zephyr/soc/snps/emsdp/Kconfig"
osource "D:/aguat/Documents/GitHub/STM32/zephyrProject/deps/zephyr/soc/snps/arc_iot/Kconfig"
osource "D:/aguat/Documents/GitHub/STM32/zephyrProject/deps/zephyr/soc/silabs/Kconfig"
osource "D:/aguat/Documents/GitHub/STM32/zephyrProject/deps/zephyr/soc/sifive/sifive_freedom/Kconfig"
osource "D:/aguat/Documents/GitHub/STM32/zephyrProject/deps/zephyr/soc/sensry/Kconfig"
osource "D:/aguat/Documents/GitHub/STM32/zephyrProject/deps/zephyr/soc/rockchip/Kconfig"
osource "D:/aguat/Documents/GitHub/STM32/zephyrProject/deps/zephyr/soc/renode/riscv_virtual/Kconfig"
osource "D:/aguat/Documents/GitHub/STM32/zephyrProject/deps/zephyr/soc/renode/cortex_r8_virtual/Kconfig"
osource "D:/aguat/Documents/GitHub/STM32/zephyrProject/deps/zephyr/soc/renesas/smartbond/Kconfig"
osource "D:/aguat/Documents/GitHub/STM32/zephyrProject/deps/zephyr/soc/renesas/rz/Kconfig"
osource "D:/aguat/Documents/GitHub/STM32/zephyrProject/deps/zephyr/soc/renesas/rx/Kconfig"
osource "D:/aguat/Documents/GitHub/STM32/zephyrProject/deps/zephyr/soc/renesas/rcar/Kconfig"
osource "D:/aguat/Documents/GitHub/STM32/zephyrProject/deps/zephyr/soc/renesas/ra/Kconfig"
osource "D:/aguat/Documents/GitHub/STM32/zephyrProject/deps/zephyr/soc/realtek/ec/Kconfig"
osource "D:/aguat/Documents/GitHub/STM32/zephyrProject/deps/zephyr/soc/raspberrypi/rpi_pico/Kconfig"
osource "D:/aguat/Documents/GitHub/STM32/zephyrProject/deps/zephyr/soc/quicklogic/eos_s3/Kconfig"
osource "D:/aguat/Documents/GitHub/STM32/zephyrProject/deps/zephyr/soc/qemu/virt_riscv/Kconfig"
osource "D:/aguat/Documents/GitHub/STM32/zephyrProject/deps/zephyr/soc/qemu/malta/Kconfig"
osource "D:/aguat/Documents/GitHub/STM32/zephyrProject/deps/zephyr/soc/openisa/rv32m1/Kconfig"
osource "D:/aguat/Documents/GitHub/STM32/zephyrProject/deps/zephyr/soc/openhwgroup/cva6/Kconfig"
osource "D:/aguat/Documents/GitHub/STM32/zephyrProject/deps/zephyr/soc/oct/osd32mp15x/Kconfig"
osource "D:/aguat/Documents/GitHub/STM32/zephyrProject/deps/zephyr/soc/nxp/s32/Kconfig"
osource "D:/aguat/Documents/GitHub/STM32/zephyrProject/deps/zephyr/soc/nxp/rw/Kconfig"
osource "D:/aguat/Documents/GitHub/STM32/zephyrProject/deps/zephyr/soc/nxp/mcx/Kconfig"
osource "D:/aguat/Documents/GitHub/STM32/zephyrProject/deps/zephyr/soc/nxp/lpc/Kconfig"
osource "D:/aguat/Documents/GitHub/STM32/zephyrProject/deps/zephyr/soc/nxp/layerscape/Kconfig"
osource "D:/aguat/Documents/GitHub/STM32/zephyrProject/deps/zephyr/soc/nxp/kinetis/Kconfig"
osource "D:/aguat/Documents/GitHub/STM32/zephyrProject/deps/zephyr/soc/nxp/imxrt/Kconfig"
osource "D:/aguat/Documents/GitHub/STM32/zephyrProject/deps/zephyr/soc/nxp/imx/Kconfig"
osource "D:/aguat/Documents/GitHub/STM32/zephyrProject/deps/zephyr/soc/nuvoton/numicro/Kconfig"
osource "D:/aguat/Documents/GitHub/STM32/zephyrProject/deps/zephyr/soc/nuvoton/numaker/Kconfig"
osource "D:/aguat/Documents/GitHub/STM32/zephyrProject/deps/zephyr/soc/nuvoton/npcx/Kconfig"
osource "D:/aguat/Documents/GitHub/STM32/zephyrProject/deps/zephyr/soc/nuvoton/npcm/Kconfig"
osource "D:/aguat/Documents/GitHub/STM32/zephyrProject/deps/zephyr/soc/nordic/Kconfig"
osource "D:/aguat/Documents/GitHub/STM32/zephyrProject/deps/zephyr/soc/neorv32/Kconfig"
osource "D:/aguat/Documents/GitHub/STM32/zephyrProject/deps/zephyr/soc/native/inf_clock/Kconfig"
osource "D:/aguat/Documents/GitHub/STM32/zephyrProject/deps/zephyr/soc/microchip/sam/Kconfig"
osource "D:/aguat/Documents/GitHub/STM32/zephyrProject/deps/zephyr/soc/microchip/miv/Kconfig"
osource "D:/aguat/Documents/GitHub/STM32/zephyrProject/deps/zephyr/soc/microchip/mec/Kconfig"
osource "D:/aguat/Documents/GitHub/STM32/zephyrProject/deps/zephyr/soc/mediatek/mt8xxx/Kconfig"
osource "D:/aguat/Documents/GitHub/STM32/zephyrProject/deps/zephyr/soc/lowrisc/opentitan/Kconfig"
osource "D:/aguat/Documents/GitHub/STM32/zephyrProject/deps/zephyr/soc/litex/litex_vexriscv/Kconfig"
osource "D:/aguat/Documents/GitHub/STM32/zephyrProject/deps/zephyr/soc/ite/ec/Kconfig"
osource "D:/aguat/Documents/GitHub/STM32/zephyrProject/deps/zephyr/soc/intel/raptor_lake/Kconfig"
osource "D:/aguat/Documents/GitHub/STM32/zephyrProject/deps/zephyr/soc/intel/lakemont/Kconfig"
osource "D:/aguat/Documents/GitHub/STM32/zephyrProject/deps/zephyr/soc/intel/intel_socfpga_std/Kconfig"
osource "D:/aguat/Documents/GitHub/STM32/zephyrProject/deps/zephyr/soc/intel/intel_socfpga/Kconfig"
osource "D:/aguat/Documents/GitHub/STM32/zephyrProject/deps/zephyr/soc/intel/intel_niosv/Kconfig"
osource "D:/aguat/Documents/GitHub/STM32/zephyrProject/deps/zephyr/soc/intel/intel_ish/Kconfig"
osource "D:/aguat/Documents/GitHub/STM32/zephyrProject/deps/zephyr/soc/intel/intel_adsp/Kconfig"
osource "D:/aguat/Documents/GitHub/STM32/zephyrProject/deps/zephyr/soc/intel/elkhart_lake/Kconfig"
osource "D:/aguat/Documents/GitHub/STM32/zephyrProject/deps/zephyr/soc/intel/atom/Kconfig"
osource "D:/aguat/Documents/GitHub/STM32/zephyrProject/deps/zephyr/soc/intel/apollo_lake/Kconfig"
osource "D:/aguat/Documents/GitHub/STM32/zephyrProject/deps/zephyr/soc/intel/alder_lake/Kconfig"
osource "D:/aguat/Documents/GitHub/STM32/zephyrProject/deps/zephyr/soc/infineon/cat3/Kconfig"
osource "D:/aguat/Documents/GitHub/STM32/zephyrProject/deps/zephyr/soc/infineon/cat1c/Kconfig"
osource "D:/aguat/Documents/GitHub/STM32/zephyrProject/deps/zephyr/soc/infineon/cat1b/Kconfig"
osource "D:/aguat/Documents/GitHub/STM32/zephyrProject/deps/zephyr/soc/infineon/cat1a/Kconfig"
osource "D:/aguat/Documents/GitHub/STM32/zephyrProject/deps/zephyr/soc/gd/gd32/Kconfig"
osource "D:/aguat/Documents/GitHub/STM32/zephyrProject/deps/zephyr/soc/gaisler/leon3/Kconfig"
osource "D:/aguat/Documents/GitHub/STM32/zephyrProject/deps/zephyr/soc/gaisler/gr716a/Kconfig"
osource "D:/aguat/Documents/GitHub/STM32/zephyrProject/deps/zephyr/soc/espressif/Kconfig"
osource "D:/aguat/Documents/GitHub/STM32/zephyrProject/deps/zephyr/soc/ene/kb1200/Kconfig"
osource "D:/aguat/Documents/GitHub/STM32/zephyrProject/deps/zephyr/soc/ene/kb106x/Kconfig"
osource "D:/aguat/Documents/GitHub/STM32/zephyrProject/deps/zephyr/soc/efinix/sapphire/Kconfig"
osource "D:/aguat/Documents/GitHub/STM32/zephyrProject/deps/zephyr/soc/cdns/xtensa_sample_controller/Kconfig"
osource "D:/aguat/Documents/GitHub/STM32/zephyrProject/deps/zephyr/soc/cdns/sample_controller32/Kconfig"
osource "D:/aguat/Documents/GitHub/STM32/zephyrProject/deps/zephyr/soc/cdns/dc233c/Kconfig"
osource "D:/aguat/Documents/GitHub/STM32/zephyrProject/deps/zephyr/soc/brcm/bcmvk/Kconfig"
osource "D:/aguat/Documents/GitHub/STM32/zephyrProject/deps/zephyr/soc/brcm/bcm2712/Kconfig"
osource "D:/aguat/Documents/GitHub/STM32/zephyrProject/deps/zephyr/soc/brcm/bcm2711/Kconfig"
osource "D:/aguat/Documents/GitHub/STM32/zephyrProject/deps/zephyr/soc/bflb/Kconfig"
osource "D:/aguat/Documents/GitHub/STM32/zephyrProject/deps/zephyr/soc/atmel/sam0/Kconfig"
osource "D:/aguat/Documents/GitHub/STM32/zephyrProject/deps/zephyr/soc/atmel/sam/Kconfig"
osource "D:/aguat/Documents/GitHub/STM32/zephyrProject/deps/zephyr/soc/aspeed/Kconfig"
osource "D:/aguat/Documents/GitHub/STM32/zephyrProject/deps/zephyr/soc/arm/Kconfig"
osource "D:/aguat/Documents/GitHub/STM32/zephyrProject/deps/zephyr/soc/arm/beetle/Kconfig"
osource "D:/aguat/Documents/GitHub/STM32/zephyrProject/deps/zephyr/soc/antmicro/myra/Kconfig"
osource "D:/aguat/Documents/GitHub/STM32/zephyrProject/deps/zephyr/soc/andestech/Kconfig"
osource "D:/aguat/Documents/GitHub/STM32/zephyrProject/deps/zephyr/soc/amd/acp_6_0/Kconfig"
osource "D:/aguat/Documents/GitHub/STM32/zephyrProject/deps/zephyr/soc/ambiq/Kconfig"
osource "D:/aguat/Documents/GitHub/STM32/zephyrProject/deps/zephyr/soc/aesc/Kconfig"
osource "D:/aguat/Documents/GitHub/STM32/zephyrProject/deps/zephyr/soc/adi/max32/Kconfig"
```
