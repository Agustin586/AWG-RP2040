/*
	Configuraicon SPI1 para STM32H755ZI-Q
	SCK 	= PA5 
	MISO 	= PA6
	MOSI	= PA7
	CS	= PD14 - Como GPIO
 */


// &spi1 {
//     status = "okay";

//     pinctrl-0 = <&spi1_sck_pa5
//                  &spi1_miso_pa6
//                  &spi1_mosi_pa7>;
//     pinctrl-names = "default";

//     cs-gpios = <&gpiod 14 GPIO_ACTIVE_LOW>;

//     ipc_bus: ipc@0 {
//         compatible = "zephyr,spi-device";
//         reg = <0>;
//         spi-max-frequency = <1000000>;
//         spi-cs-setup-delay-ns = <100>;
//         spi-cs-hold-delay-ns  = <100>;
//     };
// };

&spi1 {
    status = "okay";
    pinctrl-0 = <&spi1_sck_pa5
                 &spi1_miso_pa6
                 &spi1_mosi_pa7>;
    pinctrl-names = "default";
    cs-gpios = <&gpiod 14 GPIO_ACTIVE_LOW>;
};